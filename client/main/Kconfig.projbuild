## client/main/Kconfig.projbuild
```kconfig
menu "Train ESP Client"
    menu "Wifi Prov"
        config WIFI_AP_SSID
            string "Access point ssid"
            default "esp_device"
        config WIFI_AP_PASSWORD
            string "Access point password"
            default ""
        config WIFI_AP_MAX_CONNECTIONS
            int "Max Connections"
            default 1
    endmenu

    menu "Task Events"
        config TCP_EVENT_QUEUE_SIZE
            int "Size of the tcp event queue"
            default 10
    endmenu

    menu "RTOS Tasks"
        menu "TCP"
            config TCP_TASK_STACK
                int "Task stack size (words)"
                default 8192
            config TCP_TASK_PRIORITY
                int "Task priority"
                default 3
            config TCP_TIMEOUT_ATTEMPTS
                int "Timeout retry attempts"
                default 3
            config TCP_TIMEOUT
                int "Timeout reconnect wait"
                default 30
        endmenu
        
        menu "Battery Status"
            config BATTERY_TASK_STACK
                int "Task stack size (words)"
                default 1024
            config BATTERY_TASK_PRIORITY
                int "Task priority"
                default 1
            config BATTERY_ADC_UNIT
                int "ADC unit gpio"
                default 1
            config BATTERY_ADC_CHANNEL
                int "ADC channel gpio"
                default 6
            config BATTERY_FULLY_CHARGED
                float "Fully charged voltage"
                default 8.4
            config BATTERY_MINIMUM_SAFE
                float "Minimum safe voltage"
                default 6.3
        endmenu

        menu "Motor"
            config MOTOR_TASK_STACK
                int "Task stack size (words)"
                default 2048
            config MOTOR_TASK_PRIORITY
                int "Task priority"
                default 3
            config MOTOR_PWM_CHANNEL
                int "Pwm channel"
                default 0
            config MOTOR_PWM_GPIO
                int "Pwm pin"
                default 33
            config MOTOR_AIN_A_GPIO
                int "Ain A pin"
                default 26
            config MOTOR_AIN_B_GPIO
                int "Ain B pin"
                default 32
            config MOTOR_STANDBY_GPIO
                int "Standby pin"
                default 25
        endmenu

        menu "NFC"
            config NFC_TASK_STACK
                int "Task stack size (words)"
                default 3500
            config NFC_TASK_PRIORITY
                int "Task priority"
                default 1
            config NFC_MISO_GPIO
                int "Miso pin"
                default 19
            config NFC_MOSI_GPIO
                int "Mosi pin"
                default 18
            config NFC_SCK_GPIO
                int "Sck pin"
                default 21
            config NFC_CS_GPIO
                int "Cs pin"
                default 5
        endmenu

        menu "Train Controller"
            config TRAIN_TASK_STACK
                int "Task stack size (words)"
                default 1024
            config TRAIN_TASK_PRIORITY
                int "Task priority"
                default 3
        endmenu
    endmenu
endmenu
```
